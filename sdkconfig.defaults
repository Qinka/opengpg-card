## sdkconfig.defaults
```kconfig
# ESP32-S3 OpenPGP Card Configuration

# USB Configuration
CONFIG_TINYUSB_ENABLED=y
CONFIG_TINYUSB_CDC_ENABLED=y
CONFIG_TINYUSB_HID_ENABLED=y

# Crypto Hardware Acceleration
CONFIG_ESP32S3_DEFAULT_CPU_FREQ_240=y
CONFIG_MBEDTLS_HARDWARE_AES=y
CONFIG_MBEDTLS_HARDWARE_SHA=y
CONFIG_MBEDTLS_HARDWARE_MPI=y

# Flash Configuration
CONFIG_ESPTOOLPY_FLASHSIZE_4MB=y
CONFIG_PARTITION_TABLE_CUSTOM=y

# NVS Configuration
CONFIG_NVS_ENCRYPTION=y

# Memory Configuration
CONFIG_ESP32S3_SPIRAM_SUPPORT=y
CONFIG_SPIRAM_MODE_OCT=y
CONFIG_ESP32S3_DATA_CACHE_64KB=y
CONFIG_ESP32S3_DATA_CACHE_LINE_64B=y

# Security Features
CONFIG_SECURE_BOOT_V2_ENABLED=n
CONFIG_SECURE_FLASH_ENC_ENABLED=n

# Optimization
CONFIG_COMPILER_OPTIMIZATION_SIZE=y
CONFIG_LOG_DEFAULT_LEVEL_INFO=y
```
